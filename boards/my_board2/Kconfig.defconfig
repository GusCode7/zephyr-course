## boards/my_board2/board.yml
```yaml
board:
  name: my_board2
  full_name: My Board 2
  vendor: gustavo
  socs:
    - name: stm32f429xx
```

## boards/my_nucleo/board.yml
```yaml
board:
  name: my_nucleo
  full_name: My Nucleo F429ZI
  vendor: Gustavo Arluna
  socs:
    - name: stm32f429xx
```
